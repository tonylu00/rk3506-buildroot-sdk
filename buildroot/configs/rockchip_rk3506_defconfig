## buildroot/configs/rockchip_rk3506_defconfig
```kconfig
#include "base/base.config"
#include "chips/rk3506_arm.config"
#include "fs/vfat.config"
#include "wifibt/bt.config"
#include "wifibt/wireless.config"
#include "multimedia/audio.config"
#include "wifibt/bt.config"
#include "wifibt/wireless.config"
#include "lvgl/lvgl_rkadk.config"
#include "lvgl/rk_demo.config"
BR2_PACKAGE_CAN_UTILS=y
# BR2_PACKAGE_CHRONY is reset to default
# BR2_PACKAGE_DROPBEAR is reset to default
BR2_PACKAGE_EVTEST=y
BR2_PACKAGE_HAVEGED=y
BR2_PACKAGE_HOST_LINUX_HEADERS_CUSTOM_6_1=y
BR2_PACKAGE_IPERF3=y
BR2_PACKAGE_IPROUTE2=y
BR2_PACKAGE_IPTABLES=y
BR2_PACKAGE_IW=y
BR2_PACKAGE_LIBCAP=y
BR2_PACKAGE_MHZ=y
BR2_PACKAGE_MTD=y
BR2_PACKAGE_NTP=y
BR2_PACKAGE_PROCPS_NG=y
# BR2_PACKAGE_PULSEAUDIO is reset to default
BR2_PACKAGE_RIPGREP=y
BR2_PACKAGE_RKADK_EXAMPLES=y
BR2_PACKAGE_ROCKCHIP_RGA=y
BR2_PACKAGE_ROCKCHIP_TEST=y
BR2_PACKAGE_STRESS=y
BR2_PACKAGE_STRESS_NG=y
BR2_PACKAGE_WIRELESS_TOOLS=y
BR2_RK_DEMO_ENABLE_ASR=y
BR2_ROCKCHIP_ALSA_CONFIG_INSTALL_INIT_SCRIPT=y
BR2_ROOTFS_OVERLAY+="board/rockchip/rk3506/fast-display-overlay/ board/rockchip/rk3506/fs-overlay/"
BR2_ROOTFS_POST_BUILD_SCRIPT+="board/rockchip/rk3506/post-build-fast-display.sh"
# BR2_TARGET_GENERIC_REMOUNT_ROOTFS_RW is not set
BR2_TARGET_ROOTFS_SQUASHFS4_ZSTD=y
BR2_TARGET_ROOTFS_UBI=y
BR2_TARGET_ROOTFS_UBIFS_LEBSIZE=0x1F000
BR2_TARGET_ROOTFS_UBIFS_MAXLEBCNT=512
BR2_TARGET_ROOTFS_UBIFS_OPTS="-F -v"
BR2_TARGET_ROOTFS_UBI_SUBSIZE=2048
BR2_TIME_BITS_64=y
```
